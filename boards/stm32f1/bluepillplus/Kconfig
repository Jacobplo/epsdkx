## hal/Kconfig
```kconfig
rsource "$(FAMILY)/Kconfig"

config RX_BUFFER_SIZE
  int "Size in bytes of all communcation protocol RX buffers"
  default 64

config GPIO
  bool "Enable GPIO Driver"
config PLATFORM_SUPPORTS_GPIO
  bool

config UART
  bool "Enable UART Driver"
config PLATFORM_SUPPORTS_UART
  bool

config SPI 
  bool "Enable SPI Driver"
config PLATFORM_SUPPORTS_SPI
  bool

config I2C
  bool "Enable I2C Driver"
config PLATFORM_SUPPORTS_I2C
  bool

config USB
  bool "Enable USB Driver"
config PLATFORM_SUPPORTS_USB
  bool

config TIMING
  bool "Enable timing functions"
config PLATFORM_SUPPORTS_TIMING
  bool

config PINCTRL
  bool "Enable pin control functions"
config PLATFORM_SUPPORTS_PINCTRL
  bool
```

## modules/Kconfig
```kconfig
config MODULE_CMSIS_5
  bool "Enables CMSIS 5 headers"
  default y if MODULE_CMSIS_STM32F1

config MODULE_CMSIS_STM32F1
  bool "Enables headers for STM32F1 targets"
```

## periph/sd/Kconfig
```kconfig
config PERIPH_SD
  bool "SD card SPI mode driver"

config PERIPH_SD_FATFS
  bool "Enable FatFs usage using the SD driver"

config PERIPH_SD_FATFS_FFCONF
  bool "Enable usage of the bundled default FatFs ffconf.h"
  default y if PERIPH_SD_FATFS

config MODULE_FATFS
  default y if PERIPH_SD_FATFS
```

## sys/Kconfig
```kconfig
config CORE_CLOCK_FREQ
  int "Core clock frequency in Hz"

config LOW_POWER
  bool "Use a lower core clock frequency for lower current draw"
```
