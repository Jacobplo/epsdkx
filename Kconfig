## Kconfig
```kconfig
rsource "hal/Kconfig"
rsource "drivers/Kconfig"
rsource "boards/$(FAMILY)/$(BOARD)/Kconfig"
rsource "periph/Kconfig"

config DEBUG
  bool "Enable Debug Features"

config NEWLIB_LIBC
  bool "Use newlib for libc"
  depends on PLATFORM_SUPPORTS_NEWLIB_LIBC
  default y if NEWLIB_LIBC_NANO

config NEWLIB_LIBC_NANO
  bool "Use newlib nano for libc"
  depends on PLATFORM_SUPPORTS_NEWLIB_LIBC

config NEWLIB_LIBC_FLOAT_PRINTF
  bool "Enable floating-point specifier support for printf"
  depends on NEWLIB_LIBC
```

## hal/stm32f1/Kconfig
```kconfig
# =======
# Drivers
# =======

config PLATFORM_SUPPORTS_GPIO
  def_bool y

config PLATFORM_SUPPORTS_UART
  def_bool y

config PLATFORM_SUPPORTS_SPI
  def_bool y

config PLATFORM_SUPPORTS_I2C
  def_bool y

config PLATFORM_SUPPORTS_USB
  def_bool y

config PLATFORM_SUPPORTS_TIMING
  def_bool y

config PLATFORM_SUPPORTS_PINCTRL
  def_bool y

# ====
# LIBC
# ====

config PLATFORM_SUPPORTS_NEWLIB_LIBC
  def_bool y
```
